## boards/shields/cornec/Kconfig.defconfig
```kconfig
if SHIELD_CORNEC_LEFT

config ZMK_KEYBOARD_NAME
    default "cornec"

config ZMK_SPLIT_ROLE_CENTRAL
    default y

endif

if SHIELD_CORNEC_LEFT || SHIELD_CORNEC_RIGHT

config ZMK_SPLIT
    default y

endif
```

## boards/shields/cornec/Kconfig.shield
```kconfig
config SHIELD_CORNEC_LEFT
    def_bool $(shields_list_contains,cornec_left)

config SHIELD_CORNEC_RIGHT
    def_bool $(shields_list_contains,cornec_right)
```
